/dts-v1/;
/plugin/;

/ {
    compatible = "brcm,bcm2835", "brcm,bcm2836", "brcm,bcm2711";

    /*
     * The tft35a overlay occupies SPI0.0 for the ILI9486 display and SPI0.1
     * for the ADS7846 touch controller. Extend the same controller with a
     * third GPIO chip-select on GPIO22 for the ADS1263 HAT.
     */
    fragment@0 {
        target = <&spi0>;
        __overlay__ {
            #address-cells = <1>;
            #size-cells = <0>;
            status = "okay";
            num-cs = <3>;
            cs-gpios = <&gpio 8 1>, <&gpio 7 1>, <&gpio 22 1>;

            etr_ads1263_spidev: spidev@2 {
                compatible = "spidev";
                reg = <2>;
                spi-max-frequency = <2000000>;
                status = "okay";
            };
        };
    };
};
